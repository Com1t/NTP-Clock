#include <ESP8266WiFi.h>
#include <PubSubClient.h>
#include <Ticker.h>//Ticker Library
#include <Wire.h>
#include "SparkFunHTU21D.h"
#include <Adafruit_GFX.h>
#include <Adafruit_SSD1306.h>
#include <Fonts/FreeSans9pt7b.h>
#include <Fonts/FreeSans12pt7b.h>

#define OLED_RESET D4
Adafruit_SSD1306 display(OLED_RESET);

#define XPOS 0
#define YPOS 1
#define DELTAY 2

#if (SSD1306_LCDHEIGHT != 32)
#error("Height incorrect, please fix Adafruit_SSD1306.h!");
#endif

//IP button (SD3)
#define IPbutton 10

// light pin
#define light D0

// HTU21D sensor config.
HTU21D HTU;

// 設定無線基地台SSID跟密碼
const char* ssid     = "ASUS-G";
const char* password = "0922235662";
// 設定樹莓派 MQTT Broker 的 IP
const char* mqtt_server = "192.168.50.207";
// 初始化 espClient.
WiFiClient espClient;
PubSubClient client(espClient);

// process incoming subscribed messages and maintain its connection to the server.
Ticker subPoll;

// display fliper
uint8_t changer = 0;

const unsigned char PROGMEM comet [] = {
  0x00, 0x00, 0x00, 0x00, 0x00, 0x00, 0x00, 0x00, 0x00, 0x00, 0x00, 0x00, 0x00, 0x00, 0x00, 0x00,
  0x00, 0x00, 0x00, 0x00, 0x00, 0x00, 0x00, 0x00, 0x00, 0x00, 0x00, 0x00, 0x0F, 0xC0, 0x00, 0x00,
  0x00, 0x00, 0x00, 0x00, 0x00, 0x00, 0x00, 0x00, 0x00, 0x00, 0x00, 0x00, 0x7F, 0xF0, 0x00, 0x00,
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  0x00, 0x00, 0x00, 0x00, 0x00, 0x00, 0x00, 0x00, 0x00, 0x00, 0x00, 0x00, 0x00, 0x00, 0x00, 0x00
};

void callback(String topic, byte* message, unsigned int length);  // 當設備發訊息給一個標題(topic)時，這段函式會被執行
void reconnect();                                                 // ESP8266 重新連接到 MQTT Broker 
void subPolling();                                                // process incoming subscribed messages and maintain its connection to the server.

void setup() {
  // by default, we'll generate the high voltage from the 3.3v line internally! (neat!)
  display.begin(SSD1306_SWITCHCAPVCC, 0x3C);  // initialize with the I2C addr 0x3C (for the 128x32)
  // init done
  display.clearDisplay();
  display.drawBitmap(0, 0,  comet, 128, 32, 1);
  display.display();
  
  pinMode(light, OUTPUT);
  digitalWrite(light, HIGH);  // set HIGH to turn off Light
  pinMode(IPbutton, INPUT);
  
  Serial.begin(115200);
  
  HTU.begin();
  
  delay(700);
  display.clearDisplay();
  
  // 連接無線網路
  Serial.println();
  Serial.print("Connecting to");
  String line1 = "Connecting to";
  display.setFont();
  display.setTextColor(WHITE);
  display.setCursor(0, 0);
  display.print(line1);
  display.display();
  
  Serial.println(ssid);
  String line2 = ssid;
  display.setFont(&FreeSans12pt7b);
  display.setCursor(0, 30);
  display.print(line2);
  display.display();
  display.setFont();  // set font back to default
  WiFi.begin(ssid, password);
  uint8_t dotCounter = 0;
  while (WiFi.status() != WL_CONNECTED) {
    delay(500);
    Serial.print(".");
    line1 += ".";
    dotCounter++;
    if( dotCounter == 9 ){
      line1 = "Connecting to";
      dotCounter = 0;
      display.clearDisplay();
      display.setFont(&FreeSans12pt7b);
      display.setCursor(0, 30);
      display.print(line2);
      display.setFont();  // set font back to default
    }
    display.setTextColor(WHITE);
    display.setCursor(0, 0);
    display.print(line1);
    display.display();
  }
  Serial.println("");
  display.clearDisplay();
  
  Serial.print("WiFi connected - ESP IP address: ");
  line1 = "IP address: ";
  display.setCursor(0, 0);
  display.print(line1);
  display.display();
  
  Serial.println(WiFi.localIP());
  IPAddress locIP = WiFi.localIP();
  display.setCursor(0, 15);
  display.print(locIP);
  display.display();
  
  client.setServer(mqtt_server, 1883);    // 設定 mqtt server 及連接 port
  client.setCallback(callback);           // 設定 mqtt broker 並設定 callback function
  subPoll.attach(0.5, subPolling);      //Initialize subPoll every 0.5s
}

void loop() {
  
  if (!client.connected())
    reconnect();
    
  float temp = HTU.readTemperature();
  float humi = HTU.readHumidity();

  // dtostrf 將 float 數字改成文字
  static char temperatureTemp[7];
  dtostrf(temp, 6, 2, temperatureTemp);
  static char humidityTemp[7];
  dtostrf(humi, 6, 2, humidityTemp);

  // Publishes Temperature and Humidity values
  client.publish("room/temperature", temperatureTemp);
  client.publish("room/humidity", humidityTemp);
  Serial.print("Temperature: ");
  Serial.print(temp);
  Serial.print(" *C\t Humidity: ");
  Serial.print(humi);
  Serial.println(" % ");
  // Delay between measurements.
  delay(2000);
  display.clearDisplay();
  // the below took alomst 100ms
  String line1;
  String line2;
  display.setFont();  // set font back to default
  if( !digitalRead(IPbutton) ){
    if( changer%2 ){
      line1 = "Humidity";
      line2 = humi;
      line2 += "%";
    }
    else{
      line1 = "Temperature";
      line2 = temp;
      line2 += "*C";
    }
    changer++;
    display.setFont();
    display.setTextColor(WHITE);
    display.setCursor(0, 0);
    display.print(line1);
  
    display.setFont(&FreeSans12pt7b);
  
    display.setCursor(45, 30);
    display.print(line2);
    display.display();
  }
  else{
    Serial.print("WiFi connected - ESP IP address: ");
    line1 = "IP address: ";
    display.setCursor(0, 0);
    display.print(line1);
    display.display();
    
    Serial.println(WiFi.localIP());
    IPAddress locIP = WiFi.localIP();
    display.setCursor(0, 15);
    display.print(locIP);
    display.display();
  }
} 

// 當設備發訊息給一個標題(topic)時，這段函式會被執行
void callback(String topic, byte* message, unsigned int length) {
  Serial.print("Message arrived on topic: ");
  Serial.print(topic);
  Serial.print(". Message: ");
  String messageTemp;
  
  for (int i = 0; i < length; i++) {
    Serial.print((char)message[i]);
    messageTemp += (char)message[i];
  }
  Serial.println();

  // 假使收到訊息給主題 room/light, 可以檢查訊息是 on 或 off. 根據訊息開啟 GPIO
  if(topic=="room/light"){
      Serial.print("Changing Room light to ");
      if(messageTemp == "ON"){
        digitalWrite(light, LOW);
        Serial.print("ON");
      }
      else if(messageTemp == "OFF"){
        digitalWrite(light, HIGH);
        Serial.print("OFF");
      }
  }
  Serial.println();
}

// ESP8266 重新連接到 MQTT Broker 
void reconnect() {
  // 持續迴圈直到連線
  while (!client.connected()) {
    Serial.print("Attempting MQTT connection...");

    if (client.connect("ESP8266Client")) {
      Serial.println("connected");  
      // 訂閱一個主題，可以設定多個主題
      client.subscribe("room/light");
    } else {
      Serial.print("failed, rc=");
      Serial.print(client.state());
      Serial.println(" try again in 5 seconds");
      delay(5000);
    }
  }
}

// process incoming subscribed messages and maintain its connection to the server.
// normally done within 100 microseconds, but sometimes won't.(Won't be more than 1000 microseconds.)
void subPolling() {
  //auto i = micros();
  if(!client.loop())
    client.connect("ESP8266Client");
  //Serial.println(micros() - i);
}
